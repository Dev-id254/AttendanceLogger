## Firmware/sdkconfig.defaults
```kconfig
# Default configuration for ESP-IDF Attendance Logger

# Bluetooth Classic (SPP)
CONFIG_BT_ENABLED=y
CONFIG_BT_CLASSIC_ENABLED=y
CONFIG_BT_SPP_ENABLED=y
CONFIG_BT_L2CAP_ENABLED=y

# WiFi
CONFIG_ESP_WIFI_SSID=""
CONFIG_ESP_WIFI_PASSWORD=""
CONFIG_ESP_MAXIMUM_RETRY=5

# HTTP Client
CONFIG_ESP_HTTP_CLIENT_ENABLE_HTTPS=n

# UART
CONFIG_LOG_DEFAULT_LEVEL_INFO=y
CONFIG_CONSOLE_UART_BAUDRATE=115200
CONFIG_CONSOLE_UART_NUM=0

# Stack size
CONFIG_ESP_MAIN_TASK_STACK_SIZE=4096

# Memory
CONFIG_SPIRAM_IGNORE_NOTFOUND=n

# CPU frequency
CONFIG_ESP_DEFAULT_CPU_FREQ_MHZ=240

# FreeRTOS
CONFIG_FREERTOS_HZ=100

# Compiler optimization
CONFIG_COMPILER_OPTIMIZATION_DEFAULT=y
CONFIG_COMPILER_OPTIMIZATION_SIZE=n
```
